## Documentation/devicetree/bindings/mmc/starfive,jh7110-mmc.yaml
```yaml
# SPDX-License-Identifier: GPL-2.0-only OR BSD-2-Clause
%YAML 1.2
---
$id: http://devicetree.org/schemas/mmc/starfive,jh7110-mmc.yaml#
$schema: http://devicetree.org/meta-schemas/core.yaml#

title: StarFive Designware Mobile Storage Host Controller

description:
  StarFive uses the Synopsys designware mobile storage host controller
  to interface a SoC with storage medium such as eMMC or SD/MMC cards.

allOf:
  - $ref: synopsys-dw-mshc-common.yaml#

maintainers:
  - William Qiu <william.qiu@starfivetech.com>

properties:
  compatible:
    const: starfive,jh7110-mmc

  reg:
    maxItems: 1

  clocks:
    items:
      - description: biu clock
      - description: ciu clock

  clock-names:
    items:
      - const: biu
      - const: ciu

  interrupts:
    maxItems: 1

  starfive,syscon:
    $ref: /schemas/types.yaml#/definitions/phandle-array
    description:
      arg0:arg0 is syscon.
      arg1:arg1 is syscon register offset, used to enable MMC function.
      arg2:arg2 is used to enable the register shift of the MMC function.
      arg3:arg3 is used to enable the register mask of the MMC function.

required:
  - compatible
  - reg
  - clocks
  - clock-names
  - interrupts
  - starfive,syscon

unevaluatedProperties: false

examples:
  - |
    mmc@16010000 {
        compatible = "starfive,jh7110-mmc";
        reg = <0x16010000 0x10000>;
        clocks = <&syscrg 91>,
                 <&syscrg 93>;
        clock-names = "biu","ciu";
        resets = <&syscrg 64>;
        reset-names = "reset";
        interrupts = <74>;
        fifo-depth = <32>;
        fifo-watermark-aligned;
        data-addr = <0>;
        starfive,syscon = <&syscon 0x14 0x1a 0x7c000000>;
    };
```

## Documentation/devicetree/bindings/pinctrl/microchip,mpfs-pinctrl-mssio.yaml
```yaml
# SPDX-License-Identifier: GPL-2.0-only OR BSD-2-Clause
%YAML 1.2
---
$id: http://devicetree.org/schemas/pinctrl/microchip,mpfs-pinctrl-mssio.yaml#
$schema: http://devicetree.org/meta-schemas/core.yaml#

title: Microchip Polarfire SoC MSSIO pinctrl

maintainers:
  - Conor Dooley <conor.dooley@microchip.com>

properties:
  compatible:
    const: microchip,mpfs-pinctrl-mssio

  reg:
    maxItems: 1

  pinctrl-use-default: true

patternProperties:
  '-cfg$':
    type: object
    additionalProperties: false

    patternProperties:
      '-pins$':
        type: object
        additionalProperties: false

        allOf:
          - $ref: pincfg-node.yaml#
          - $ref: pinmux-node.yaml#

        properties:
          pins:
            description: |
              The list of IOs that properties in the pincfg node apply to.

          function:
            description:
              A string containing the name of the function to mux for these
              pins. The "reserved" function tristates a pin.
            enum: [ sd, emmc, qspi, spi, usb, uart, i2c, can, mdio, misc
                    reserved, gpio, fabric-test, tied-low, tied-high, tristate ]

          bias-bus-hold: true
          bias-disable: true
          bias-pull-down: true
          bias-pull-up: true
          input-schmitt-enable: true
          low-power-enable: true

          drive-strength:
            enum: [ 2, 4, 6, 8, 10, 12, 16, 20 ]

          microchip,clamp-diode:
            $ref: /schemas/types.yaml#/definitions/flag
            description: |
              Reflects the "Clamp Diode" setting in the MSS Configurator for
              this pin.

          microchip,bank-lockdown:
            $ref: /schemas/types.yaml#/definitions/flag
            description: |
              Reflects the "Lock Down Bank{2,4} I/Os" setting in the MSS
              Configurator for this pin.

          microchip,ibufmd:
            $ref: /schemas/types.yaml#/definitions/uint32
            default: 0
            description: |
              Reflects the "IBUFMD" bits in the MSS Configurator output files
              for this pin.

        required:
          - pins
          - function

required:
  - compatible
  - reg

additionalProperties: false

examples:
  - |
    pinctrl@204 {
      compatible = "microchip,mpfs-pinctrl-mssio";
      reg = <0x204 0x7c>;

      irkd_sd_cfg: irkd-sd-cfg {
        sd-10ma-pins {
          pins = <0>, <1>, <2>, <3>, <4>, <5>, <8>, <9>, <10>, <11>, <12>, <13>;
          function = "sd";
          bias-pull-up;
          drive-strength = <10>;
        };

        sd-8ma-pins {
          pins = <6>, <7>;
          function = "sd";
          bias-pull-up;
          drive-strength = <8>;
        };
      };
    };
...
```

## drivers/soc/canaan/Kconfig
```kconfig
# SPDX-License-Identifier: GPL-2.0

config SOC_K210_SYSCTL
	bool "Canaan Kendryte K210 SoC system controller"
	depends on ARCH_CANAAN && OF
	default ARCH_CANAAN
        select PM
        select MFD_SYSCON
	help
	  Canaan Kendryte K210 SoC system controller driver.
```
